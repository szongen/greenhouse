/********************************************************************************************************************************************
*                                                                                                                                           *
*                ---------------------------------以下是模块的修改记录区---------------------------------                                   *
*                                                                                                                                           *
********************************************************************************************************************************************/
/***********************************************
 * 内容：系统时钟
 * 日期：2016/7/8
 * 作者：陈勇
 * 版本号：V1.0（初版）
 ***********************************************
 * 修改内容：1.增加时间片轮询法需要用到的时间点。
 *           2.将原来的2个文件分成4个文件，文件名中带"S"的是该模块的系统代码，用户不可以修改，带"U"的是该模块的用户代码，需要添加用户代码后才能使用该模块。
 *           3.取消利用变量自动溢出的方式，改用人工查询溢出方式。
 * 修改日期：2016/9/23
 * 修改作者：陈勇
 * 版本号：V1.1
 ***********************************************
 ***********************************************
 * 修改内容：取消所有变量都使用"volatile"关键字。
 * 修改日期：2017/10/24
 * 修改作者：陈勇
 * 版本号：V1.2
 ***********************************************/


/********************************************************************************************************************************************
*                                                                                                                                           *
*                ---------------------------------以下是模块的使用说明区---------------------------------                                   *
*                                                                                                                                           *
********************************************************************************************************************************************/
/*                                           模块使用说明：
 *
 * 该模块是项目工程的系统基准时钟，有"秒"和"毫秒"两种单位，主要用于项目中要求不高的定时，秒操作的误差是"±1秒"，毫秒操作的误差是"±10毫秒"，本
 * 模块必须使用扫描方式，具体使用步骤如下：
 * 1.使用函数"API_SystemClock_Init"初始化系统时钟，在函数里使用一个MCU的硬件定时器，设置成每10毫秒中断一次，这个定时器初始化时就必须启动，并
 *   且不管发生任何事都不能停止（包括MCU进入休眠状态），要在项目主循环之前进行初始化。
 * 2.将"API_SystemClock_ReferenceClock"函数放在MCU硬件定时器的中断服务函数里（就是第一步初始化的那个定时器）。
 * 3.当需要启动定时时，用一个无符号16位变量获取系统的当前时间，即"API_SystemClock_CurrentTime_ms"函数或"API_SystemClock_CurrentTime_s"函数的
 *   输出值。
 * 4.在需要定时的地方扫描"API_SystemClock_TimingQuery_ms"函数或"API_SystemClock_TimingQuery_s"函数的输出值，当输出为"TimeOut"说明时间到，如
 *   果输出"NoTimeOut"说明时间没到。
 * 注：该模块必须使用扫描方式，需要定时就扫描"API_SystemClock_TimingQuery_ms"函数或"API_SystemClock_TimingQuery_s"函数，不需要就不要扫描，没
 *     有停止选项。
 * 
 * 该模块的第二个功能是为分时任务提供时间点，用户可以让任务在指定的时间点里运行，或将数个连续的时间点组成一个时段，让任务只在这个时段里运行，
 * 具体使用步骤如下：
 * 1.在"API_U_SystemClock.h"文件里设置最大时间点，参数为0~65535，1点表示10ms，运行时时间点会在"0~最大时间点"之间循环（包含"0"和"最大时间点"）。
 * 2.调用"API_SystemClock_TimePoint"函数可获取当前时间点。
 *
 */
#include "stm32f1xx_hal.h"
#include "API_S_SystemClock.h"
#include "API_U_SystemClock.h"
/********************************************************************************************************************************************
*                                                                                                                                           *
*               ---------------------------------以下是模块的对接函数区---------------------------------                                    *
*                                                                                                                                           *
********************************************************************************************************************************************/


/********************************************************************************************************************************************
*                                                                                                                                           *
*               ---------------------------------以下是模块的内部函数申明区---------------------------------                                *
*                                                                                                                                           *
********************************************************************************************************************************************/


/********************************************************************************************************************************************
*                                                                                                                                           *
*               ---------------------------------以下是模块的变量申明和宏定义区---------------------------------                            *
*                                                                                                                                           *
********************************************************************************************************************************************/
static uint16_t SystemClock_ms = 0;  //系统时钟（毫秒）
static uint16_t SystemClock_s = 0;  //系统时钟（秒）
//static uint16_t SystemClock_min = 0;  //系统时钟（分钟）
uint16_t SystemClock_min = 0;  //系统时钟（分钟）
static uint16_t TimePoint = 0;  //时间点，为分时任务提供时间点


/********************************************************************************************************************************************
*                                                                                                                                           *
*                ---------------------------------以下是模块的系统函数代码区---------------------------------                               *
*                                                                                                                                           *
********************************************************************************************************************************************/
/***************************************************************************
* 函数名：  API_SystemClock_CurrentTime_ms
* 功能描述：获取当前时间（毫秒），用于定时查询
* 入口参数：无
* 出口参数：16位无符号数的当前时间（毫秒）
* 注意事项：可随时调用该函数来获取当前时间，就是"API_SystemClock_TimingQuery_ms"
*           函数的第1个输入参数"StartingTime_ms"
* 修改记录：无
*           2016/7/8 BY:陈勇
***************************************************************************/
uint16_t API_SystemClock_CurrentTime_ms(void)
{
    return SystemClock_ms;
}


/***************************************************************************
* 函数名：  API_SystemClock_CurrentTime_s
* 功能描述：获取当前时间（秒），用于定时查询
* 入口参数：无
* 出口参数：16位无符号数的当前时间（秒）
* 注意事项：可随时调用该函数来获取当前时间，就是"API_SystemClock_TimingQuery_s"
*           函数的第1个输入参数"StartingTime_s"
* 修改记录：无
*           2016/7/8 BY:陈勇
***************************************************************************/
uint16_t API_SystemClock_CurrentTime_s(void)
{
    return SystemClock_s;
}


/***************************************************************************
* 函数名：  API_SystemClock_CurrentTime_min
* 功能描述：获取当前时间（分钟），用于定时查询
* 入口参数：无
* 出口参数：16位无符号数的当前时间（分钟）
* 注意事项：可随时调用该函数来获取当前时间，就是"API_SystemClock_TimingQuery_min"
*           函数的第1个输入参数"StartingTime_min"
* 修改记录：无
*           2018/4/12 BY:陈勇
***************************************************************************/
uint16_t API_SystemClock_CurrentTime_min(void)
{
    return SystemClock_min;
}


/***************************************************************************
* 函数名：  API_SystemClock_TimePoint
* 功能描述：获取当前时间点，为分时任务提供时段
* 入口参数：无
* 出口参数：16位无符号数的当前时间点
* 注意事项：1.可随时调用该函数来获取当前时间点。
*           2.单位为10ms
* 修改记录：无
*           2016/7/8 BY:陈勇
***************************************************************************/
uint16_t API_SystemClock_TimePoint(void)
{
    return TimePoint;
}


/***************************************************************************
* 函数名：  API_SystemClock_ReferenceClock
* 功能描述：系统基准时钟（10毫秒）
* 入口参数：无
* 出口参数：无
* 注意事项：该函数必须放在定时器中断服务函数里，定时器设置为每10毫秒中断一次，
*           定时器必须一直处于运行状态，不能停止。
* 修改记录：无
*           2016/7/8 BY:陈勇
***************************************************************************/
void API_SystemClock_ReferenceClock(void)
{
    static uint8_t a = 0;
    static uint8_t b = 0;
    
//    SystemClock_ms ++;  //进入该函数一次系统时钟就增加10ms
    if(SystemClock_ms == 0xffff)
    {
        SystemClock_ms = 0;
    }
    else
    {
        SystemClock_ms ++;
    }
    
    a ++;
    if(a > 99)  //100*10ms=1000ms=1s
    {
        a = 0;
        
//        SystemClock_s ++;  //系统时钟增加1s
        if(SystemClock_s == 0xffff)
        {
            SystemClock_s = 0;
        }
        else
        {
            SystemClock_s ++;
        }
        
        b ++;
        if(b > 59)  //60s=1min
        {
            b = 0;
            
//            SystemClock_min ++;  //系统时间增加1分钟
            if(SystemClock_min == 0xffff)
            {
                SystemClock_min = 0;
            }
            else
            {
                SystemClock_min ++;
            }
        }
    }
    
    TimePoint ++;  //时间点每10ms增加一次
    if(TimePoint > MaximumTimePoint)  //如果超过最大时间点
    {
        TimePoint = 0;
    }
}


/***************************************************************************
* 函数名：  API_SystemClock_TimingQuery_ms
* 功能描述：定时时间查询（毫秒）
* 入口参数：StartingTime_ms：起始时间，就是"API_SystemClock_CurrentTime_ms"函数的输出参数
*           TimingHowLong_ms：需要定时的时间，取值范围是"1"~"65535"中能被10整除的数
* 出口参数：TimeOut：定时时间已到
*           NoTimeOut：定时时间还没到
* 注意事项：该函数的时间单位是毫秒
* 修改记录：无
*           2016/7/8 BY:陈勇
***************************************************************************/
uint8_t API_SystemClock_TimingQuery_ms(uint16_t StartingTime_ms,uint16_t TimingHowLong_ms)
{
//    vuint16_t a;
//    
//    TimingHowLong_ms = (TimingHowLong_ms / 10) - 1;  //定时器是每10毫秒中断一次，减1是为了下面判断时用">"而不用">="
//    a = SystemClock_ms - StartingTime_ms;  //系统时钟（当前时间）- 起始时间 = 已经过去了多少时间
//    if(a > TimingHowLong_ms)  //已经过去的时间是否大于或等于需要定时的时间
//    {
//        return TimeOut;  //是的话说明定时时间已到
//    }
//    else
//    {
//        return NoTimeOut;  //不是的话说明定时时间还没到
//    }
    
    
    uint16_t i;
    
    if(SystemClock_ms < StartingTime_ms)  //如果"当前时间 < 起始时间"说明时间变量有溢出
    {
        i = (SystemClock_ms + (0xffff - StartingTime_ms)) + 1;
    }
    else  //如果"当前时间 >= 起始时间"说明时间变量没有溢出
    {
        i = SystemClock_ms - StartingTime_ms;
    }
    
    TimingHowLong_ms = TimingHowLong_ms / 10;  //定时器是每10毫秒中断一次
    if(i >= TimingHowLong_ms)  //已经过去的时间是否大于或等于需要定时的时间
    {
        return TimeOut;  //是的话说明定时时间已到
    }
    else
    {
        return NoTimeOut;  //不是的话说明定时时间还没到
    }
}


/***************************************************************************
* 函数名：  API_SystemClock_TimingQuery_s
* 功能描述：定时时间查询（秒）
* 入口参数：StartingTime_s：起始时间，就是"API_SystemClock_CurrentTime_s"函数的输出参数
*           TimingHowLong_s：需要定时的时间，取值范围是"1"~"65535"
* 出口参数：TimeOut：定时时间已到
*           NoTimeOut：定时时间还没到
* 注意事项：该函数的时间单位是秒
* 修改记录：无
*           2016/7/8 BY:陈勇
***************************************************************************/
uint8_t API_SystemClock_TimingQuery_s(uint16_t StartingTime_s,uint16_t TimingHowLong_s)
{
//    vuint16_t a;
//    
//    TimingHowLong_s --;  //减1是为了下面判断时用">"而不用">="
//    a = SystemClock_s - StartingTime_s;  //系统时钟（当前时间）- 起始时间 = 已经过去了多少时间
//    if(a > TimingHowLong_s)  //已经过去的时间是否大于或等于需要定时的时间
//    {
//        return TimeOut;  //是的话说明定时时间已到
//    }
//    else
//    {
//        return NoTimeOut;  //不是的话说明定时时间还没到
//    }
    
    
    uint16_t k;
    
    if(SystemClock_s < StartingTime_s)  //如果"当前时间 < 起始时间"说明时间变量有溢出
    {
        k = (SystemClock_s + (0xffff - StartingTime_s)) + 1;
    }
    else  //如果"当前时间 >= 起始时间"说明时间变量没有溢出
    {
        k = SystemClock_s - StartingTime_s;
    }
    
    if(k >= TimingHowLong_s)  //已经过去的时间是否大于或等于需要定时的时间
    {
        return TimeOut;  //是的话说明定时时间已到
    }
    else
    {
        return NoTimeOut;  //不是的话说明定时时间还没到
    }
}


/***************************************************************************
* 函数名：  API_SystemClock_TimingQuery_min
* 功能描述：定时时间查询（分钟）
* 入口参数：StartingTime_min：起始时间，就是"API_SystemClock_CurrentTime_min"函数的输出参数
*           TimingHowLong_min：需要定时的时间，取值范围是"1"~"65535"
* 出口参数：TimeOut：定时时间已到
*           NoTimeOut：定时时间还没到
* 注意事项：该函数的时间单位是分钟
* 修改记录：无
*           2018/4/12 BY:陈勇
***************************************************************************/
uint8_t API_SystemClock_TimingQuery_min(uint16_t StartingTime_min,uint16_t TimingHowLong_min)
{
    uint16_t k;
    
    if(SystemClock_min < StartingTime_min)  //如果"当前时间 < 起始时间"说明时间变量有溢出
    {
        k = (SystemClock_min + (0xffff - StartingTime_min)) + 1;
    }
    else  //如果"当前时间 >= 起始时间"说明时间变量没有溢出
    {
        k = SystemClock_min - StartingTime_min;
    }
    
    if(k >= TimingHowLong_min)  //已经过去的时间是否大于或等于需要定时的时间
    {
        return TimeOut;  //是的话说明定时时间已到
    }
    else
    {
        return NoTimeOut;  //不是的话说明定时时间还没到
    }
}


/********************************************************************************************************************************************
*                                                                                                                                           *
*               ---------------------------------以下是模块的内部函数代码区---------------------------------                                *
*                                                                                                                                           *
********************************************************************************************************************************************/


/********************************************************************************************************************************************
*                                                                                                                                           *
*               ---------------------------------以下是模块的用户函数代码区---------------------------------                                *
*                                                                                                                                           *
********************************************************************************************************************************************/


